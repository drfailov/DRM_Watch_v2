#include <Arduino.h>
#include "GenericWatchface.cpp"
#include "Display.cpp"
#include "RTC.cpp"
#include "Battery.cpp"
#include "MyEEPROM.cpp"


#ifndef WATCHFACETHERMOCPP
#define WATCHFACETHERMOCPP

// 'calibri0', 17x23px
const unsigned char  thermo0 [] PROGMEM = {
  0x80, 0xf0, 0xfc, 0xfe, 0xfe, 0x3f, 0x0f, 0x0f, 0x0f, 0x0f, 0x0f, 0x1f, 0xff, 0xfe, 0xfc, 0xf8, 
  0xe0, 0xff, 0xff, 0xff, 0xff, 0xff, 0x00, 0x00, 0x00, 0x00, 0x00, 0x00, 0x00, 0xff, 0xff, 0xff, 
  0xff, 0xff, 0x01, 0x0f, 0x1f, 0x3f, 0x7f, 0x7e, 0x78, 0x70, 0x70, 0x70, 0x78, 0x7c, 0x7f, 0x3f, 
  0x1f, 0x0f, 0x01
};
// 'calibri1', 17x23px
const unsigned char  thermo1 [] PROGMEM = {
  0x00, 0x00, 0x78, 0x38, 0x3c, 0x1c, 0x1e, 0xff, 0xff, 0xff, 0xff, 0xff, 0x00, 0x00, 0x00, 0x00, 
  0x00, 0x00, 0x00, 0x00, 0x00, 0x00, 0x00, 0x00, 0xff, 0xff, 0xff, 0xff, 0xff, 0x00, 0x00, 0x00, 
  0x00, 0x00, 0x00, 0x00, 0x78, 0x78, 0x78, 0x78, 0x78, 0x7f, 0x7f, 0x7f, 0x7f, 0x7f, 0x78, 0x78, 
  0x78, 0x78, 0x20
};
// 'calibri2', 17x23px
const unsigned char  thermo2 [] PROGMEM = {
  0x00, 0x3c, 0x1e, 0x1e, 0x0f, 0x0f, 0x0f, 0x0f, 0x0f, 0x1f, 0xff, 0xff, 0xfe, 0xfe, 0xfc, 0xf0, 
  0x00, 0x00, 0x00, 0x00, 0x00, 0x80, 0xc0, 0xe0, 0xf0, 0xf8, 0xfe, 0x7f, 0x3f, 0x1f, 0x0f, 0x07, 
  0x00, 0x00, 0x00, 0x7c, 0x7e, 0x7f, 0x7f, 0x7f, 0x7f, 0x7b, 0x79, 0x78, 0x78, 0x78, 0x78, 0x78, 
  0x78, 0x78, 0x70
};
// 'calibri3', 17x23px
const unsigned char  thermo3 [] PROGMEM = {
  0x00, 0x1c, 0x1e, 0x0e, 0x0f, 0x0f, 0x0f, 0x0f, 0x0f, 0x0f, 0xff, 0xff, 0xfe, 0xfe, 0xfc, 0x20, 
  0x00, 0x00, 0x00, 0x00, 0x1c, 0x1c, 0x1c, 0x1c, 0x1e, 0x1e, 0x3f, 0x7f, 0xff, 0xff, 0xf3, 0xf1, 
  0xe0, 0x80, 0x00, 0x3c, 0x78, 0x78, 0x78, 0x70, 0x70, 0x70, 0x70, 0x78, 0x7c, 0x7f, 0x3f, 0x3f, 
  0x1f, 0x0f, 0x03
};
// 'calibri4', 17x23px
const unsigned char  thermo4 [] PROGMEM = {
  0x00, 0x00, 0x00, 0x00, 0xc0, 0xf0, 0xf8, 0xfe, 0x3f, 0x1f, 0xff, 0xff, 0xff, 0xff, 0xfe, 0x00, 
  0x00, 0xe0, 0xf8, 0xfc, 0xff, 0x9f, 0x87, 0x83, 0x80, 0x80, 0x80, 0xff, 0xff, 0xff, 0xff, 0xff, 
  0x80, 0x80, 0x03, 0x03, 0x03, 0x03, 0x03, 0x03, 0x03, 0x03, 0x03, 0x03, 0x7f, 0x7f, 0x7f, 0x7f, 
  0x7f, 0x03, 0x03
};
// 'calibri5', 17x23px
const unsigned char  thermo5 [] PROGMEM = {
  0x00, 0x00, 0xff, 0xff, 0xff, 0xff, 0x0f, 0x0f, 0x0f, 0x0f, 0x0f, 0x0f, 0x0f, 0x0f, 0x0f, 0x00, 
  0x00, 0x00, 0x00, 0x1f, 0x1f, 0x1f, 0x0f, 0x0e, 0x0e, 0x1e, 0x1e, 0x3e, 0xfe, 0xfc, 0xfc, 0xf8, 
  0xf0, 0x80, 0x00, 0x3c, 0x78, 0x78, 0x70, 0x70, 0x70, 0x70, 0x70, 0x78, 0x7c, 0x7f, 0x3f, 0x3f, 
  0x1f, 0x0f, 0x00
};
// 'calibri6', 17x23px
const unsigned char  thermo6 [] PROGMEM = {
  0x00, 0xc0, 0xf0, 0xf8, 0xfc, 0xfe, 0x1e, 0x0f, 0x0f, 0x0f, 0x07, 0x07, 0x0f, 0x0f, 0x0f, 0x0e, 
  0x00, 0x00, 0xff, 0xff, 0xff, 0xff, 0x1c, 0x1e, 0x0e, 0x0e, 0x0e, 0x0e, 0x1e, 0xfe, 0xfe, 0xfc, 
  0xfc, 0xf0, 0x00, 0x07, 0x1f, 0x3f, 0x7f, 0x7f, 0x78, 0x70, 0x70, 0x70, 0x78, 0x78, 0x7f, 0x3f, 
  0x3f, 0x0f, 0x07
};
// 'calibri7', 17x23px
const unsigned char  thermo7 [] PROGMEM = {
  0x00, 0x0f, 0x0f, 0x0f, 0x0f, 0x0f, 0x0f, 0x0f, 0x0f, 0x0f, 0xcf, 0xff, 0xff, 0xff, 0xff, 0x3f, 
  0x0e, 0x00, 0x00, 0x00, 0x00, 0x00, 0x00, 0xc0, 0xf0, 0xfc, 0xff, 0xff, 0x7f, 0x1f, 0x07, 0x01, 
  0x00, 0x00, 0x00, 0x00, 0x00, 0x60, 0x78, 0x7e, 0x7f, 0x7f, 0x3f, 0x0f, 0x01, 0x00, 0x00, 0x00, 
  0x00, 0x00, 0x00
};
// 'calibri8', 17x23px
const unsigned char  thermo8 [] PROGMEM = {
  0x00, 0xf8, 0xfc, 0xfe, 0xfe, 0xff, 0x0f, 0x07, 0x07, 0x07, 0x0f, 0x9f, 0xff, 0xfe, 0xfe, 0xfc, 
  0x00, 0x00, 0xc1, 0xe3, 0xf7, 0xf7, 0x7f, 0x3f, 0x3e, 0x1e, 0x3e, 0x3f, 0x7f, 0xff, 0xf3, 0xf1, 
  0xe0, 0x80, 0x0f, 0x1f, 0x3f, 0x7f, 0x7f, 0x78, 0x70, 0x70, 0x70, 0x70, 0x70, 0x78, 0x7f, 0x7f, 
  0x3f, 0x1f, 0x0f
};
// 'calibri9', 17x23px
const unsigned char  thermo9 [] PROGMEM = {
  0xe0, 0xf8, 0xfc, 0xfe, 0xfe, 0x1f, 0x0f, 0x07, 0x07, 0x0f, 0x0f, 0x3f, 0xfe, 0xfe, 0xfc, 0xf8, 
  0x80, 0x03, 0x0f, 0x1f, 0x3f, 0x3f, 0x3c, 0x78, 0x78, 0x78, 0x38, 0x38, 0x3c, 0xff, 0xff, 0xff, 
  0xff, 0x7f, 0x00, 0x38, 0x78, 0x78, 0x70, 0x70, 0x70, 0x70, 0x70, 0x78, 0x7c, 0x3f, 0x3f, 0x1f, 
  0x0f, 0x03, 0x00
};
// 'markC', 24x24px
const unsigned char  markC [] PROGMEM = {
  0x0c, 0x1e, 0x33, 0x33, 0x1e, 0x0c, 0x00, 0x80, 0xe0, 0xf0, 0xf8, 0xfc, 0xfc, 0x7c, 0x3e, 0x1e, 
  0x1e, 0x1e, 0x1e, 0x1e, 0x1e, 0x3c, 0x3c, 0x78, 0x00, 0x00, 0x00, 0x00, 0x00, 0x00, 0x30, 0xff, 
  0xff, 0xff, 0xff, 0xff, 0x00, 0x00, 0x00, 0x00, 0x00, 0x00, 0x00, 0x00, 0x00, 0x00, 0x00, 0x00, 
  0x00, 0x00, 0x00, 0x00, 0x00, 0x00, 0x00, 0x07, 0x0f, 0x3f, 0x3f, 0x7f, 0xfe, 0xf8, 0xf0, 0xf0, 
  0xf0, 0xf0, 0xf0, 0xf0, 0xf0, 0xf0, 0x78, 0x78
};



class WatchfaceThermo : public GenericWatchface  { //
  public :
    virtual const char* name() {
      return (const char*)F("Thermo");
    }
    

    /*
       EN:
       Drawing watchfacw 1 (DRM Watch). Arguments:
       hour, minute, second, day, month, year, dayOfWeek - current values to draw
       animate - 0=draw without animation, 1 - animate slowly, 2 - animate more quickly, ...
       RU:
       Рисование циферблата 1 (DRM Watch). Принимает аргументы:
       hour, minute, second, day, month, year, dayOfWeek - текущие значения которые нужно вывести на циферблат
       animate - Анимировать ли вывод. 0 = не анимировать. 1 = анимировать медленно, 2 = анимировать быстрее ...
    */
    virtual void drawWatchface(byte hour, byte minute, byte second, byte day, byte month, int year, byte dayOfWeek, byte animate)
    {
        Display.displayClear();

        byte X = 96;        
        {//battery
          X -= 17;
          Display.displayDrawBattery(X, 61);
          if(!Battery.batteryIsCharging() && !Battery.batteryIsLowPower()) X += 5;
        }
        
        Display.displayDrawText(15, 7, 1, F("Temperature"));
        
      
        
        {//Temperature
          float temp = RTC.rtcGetTemp(); //-26.5
          bool minus = temp < 0; //true
          if(minus)
            temp = -temp; //26.5
          int tempInt = temp * 10; //265
          byte temp1 = tempInt / 100; //2
          byte temp2 = tempInt - (temp1 * 100); //265-(2*100) = 65
          temp2 = temp2 / 10; // 6
          byte temp3 = tempInt - (temp1 * 100) - (temp2 * 10); //265-(2*100)-(6*10)=5

          //+ \ -
          Display.displayFillRect(/*x*/0, /*y*/34, /*w*/10, /*h*/4, /*c*/1);
          if(!minus)
            Display.displayFillRect(/*x*/3, /*y*/31, /*w*/4, /*h*/10, /*c*/1);
            
          drawNumber(/*x*/11, /*y*/24, /*num*/temp1, /*animate*/ animate);
          drawNumber(/*x*/30, /*y*/24, /*num*/temp2, /*animate*/ animate);
          Display.displayFillCircle(/*x*/50, /*y*/44, /*r*/ 2, /*color*/ 1);
          drawNumber(/*x*/54, /*y*/24, /*num*/temp3, /*animate*/ animate);
          Display.displayDrawBitmap(/*x*/73, /*y*/23, /*bmp*/markC, /*w*/24, /*h*/24, /*COLOR*/1);
        }
        
        Display.displayUpdate();
    }

    

    void drawNumber(byte x, byte y, byte num, byte animate){
      if(num == 0)
        Display.displayDrawBitmap(/*x*/x, /*y*/y, /*bmp*/thermo0, /*w*/17, /*h*/23, /*COLOR*/1);
      if(num == 1)
        Display.displayDrawBitmap(/*x*/x, /*y*/y, /*bmp*/thermo1, /*w*/17, /*h*/23, /*COLOR*/1);
      if(num == 2)
        Display.displayDrawBitmap(/*x*/x, /*y*/y, /*bmp*/thermo2, /*w*/17, /*h*/23, /*COLOR*/1);
      if(num == 3)
        Display.displayDrawBitmap(/*x*/x, /*y*/y, /*bmp*/thermo3, /*w*/17, /*h*/23, /*COLOR*/1);
      if(num == 4)
        Display.displayDrawBitmap(/*x*/x, /*y*/y, /*bmp*/thermo4, /*w*/17, /*h*/23, /*COLOR*/1);
      if(num == 5)
        Display.displayDrawBitmap(/*x*/x, /*y*/y, /*bmp*/thermo5, /*w*/17, /*h*/23, /*COLOR*/1);
      if(num == 6)
        Display.displayDrawBitmap(/*x*/x, /*y*/y, /*bmp*/thermo6, /*w*/17, /*h*/23, /*COLOR*/1);
      if(num == 7)
        Display.displayDrawBitmap(/*x*/x, /*y*/y, /*bmp*/thermo7, /*w*/17, /*h*/23, /*COLOR*/1);
      if(num == 8)
        Display.displayDrawBitmap(/*x*/x, /*y*/y, /*bmp*/thermo8, /*w*/17, /*h*/23, /*COLOR*/1);
      if(num == 9)
        Display.displayDrawBitmap(/*x*/x, /*y*/y, /*bmp*/thermo9, /*w*/17, /*h*/23, /*COLOR*/1);
      if(animate)
        Display.displayUpdate();
    }

};

#endif
